## goertzel/components/wifi/Kconfig.projbuild
```kconfig
menu "WI-FI"

config WIFI_SSID
	string "WI-FI SSID"
	default "ssid"
	help
		Name of the WIFI access point

config WIFI_PASS
	string "WI-FI Password"
	default "password"
	help
		Password for the WIFI access point

config WIFI_RETRY
	int "WI-FI RETRY"
	default 0
	help
        Set the Maximum retry to avoid station reconnecting to the AP unlimited when the AP is really inexistent, 0 for infinite retry.

endmenu
```

## smartspeaker/components/bt_sink/Kconfig.projbuild
```kconfig
menu "Smart Speaker"

config BT_SINK_DEVICE_NAME
	string "Bluetooth device name"
	default "smartspeaker_a5"
	help
		Name by which the smart speaker shows up using bluetooth

endmenu
```

## smartspeaker/components/hue/Kconfig.projbuild
```kconfig
menu "Hue"

    config HUE_ENABLED
        bool "Hue status"
        default n
        help
            Enable or disable the hue feature.


endmenu
```

## smartspeaker/components/lcd/Kconfig.projbuild
```kconfig
menu "LCD"

    config I2C_MASTER_SCL
        int "I2C Master SCL GPIO number"
        range 0 34
        default 23
        help
            GPIO number (IOxx) for I2C SCL.

            Some GPIOs are used for other purposes (flash connections, etc.) and cannot be used.

            GPIOs 35-39 are input-only so cannot be used to drive the One Wire Bus.

    config I2C_MASTER_SDA
        int "I2C Master SDA GPIO number"
        range 0 34
        default 18
        help
            GPIO number (IOxx) for I2C SDA.

            Some GPIOs are used for other purposes (flash connections, etc.) and cannot be used.

            GPIOs 35-39 are input-only so cannot be used to drive the One Wire Bus.

    config LCD1602_I2C_ADDRESS
        hex "I2C Address for LCD1602 device"
        default 0x27
        help
            I2C address for HD44780-compatible LCD1602 device.

    config LCD_NUM_ROWS
        int "Number of rows that the lcd has"
        default 4
        help 
            This is the number of rows that the LCD1602 has.

    config LCD_NUM_COLUMNS
        int "Number of columns that the lcd has"
        default 40
        help 
            This is the number of columns that the LCD1602 has. 

    config LCD_NUM_VISIBLE_COLUMNS
        int "Number of visible colums the lcd is able to display right now"
        default 20
        help 
            This is the number of visible colums that the LCD1602 has right now.

    endmenu
    
```

## smartspeaker/components/led_controller_commands/Kconfig.projbuild
```kconfig
menu "Led Controller"

    config LED_CONTROLLER_ENABLED
        bool "Led controller status"
        default y
        help
            Enable or disable the led controller.


endmenu
```

## smartspeaker/components/radio/Kconfig.projbuild
```kconfig
menu "Example Configuration"
    
    config WIFI_SSID
        string "Wi-Fi SSID"
        default "change_me"
        help
            SSID (Wi-Fi network name) to connect to.

    config WIFI_PASS
        string "Wi-Fi password"
        default "change_me"
        help
            Wi-Fi password to use for connecting.
    
endmenu
```
